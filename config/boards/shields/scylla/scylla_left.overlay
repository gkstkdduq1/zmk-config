/*
 * Copyright (c) 2022 The ZMK Contributors
 *
 * SPDX-License-Identifier: MIT
 */

#include "scylla.dtsi"

/ {
    chosen {
        zmk,kscan = &kscan;
    };

    kscan: kscan {
        compatible = "zmk,kscan-gpio-matrix";

        label = "KSCAN";
        diode-direction = "row2col";

        row-gpios
            = <&gpio0 31 GPIO_ACTIVE_HIGH>
            , <&gpio1 15 GPIO_ACTIVE_HIGH>
            , <&gpio0 24 GPIO_ACTIVE_HIGH>
            , <&gpio0 22 GPIO_ACTIVE_HIGH>
            , <&gpio1 6 GPIO_ACTIVE_HIGH>
	    ;	

        col-gpios
            = <&gpio0 2 (GPIO_PULL_DOWN |GPIO_ACTIVE_HIGH)>
            , <&gpio0 29 (GPIO_PULL_DOWN |GPIO_ACTIVE_HIGH)>
            , <&gpio0 9 (GPIO_PULL_DOWN |GPIO_ACTIVE_HIGH)>
            , <&gpio1 0 (GPIO_PULL_DOWN |GPIO_ACTIVE_HIGH)>
            , <&gpio0 11 (GPIO_PULL_DOWN |GPIO_ACTIVE_HIGH)>
            , <&gpio1 4 (GPIO_PULL_DOWN |GPIO_ACTIVE_HIGH)>
            ;
    };
};



